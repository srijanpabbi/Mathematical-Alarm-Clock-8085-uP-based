LCDRS EQU 02H
LCDEN EQU 04H
PORTA EQU 01H
PORTB EQU 02H
PORTC EQU 03H
RTCSEC EQU 8100H
RTCASEC EQU 8101H
RTCMIN EQU 8102H
RTCAMIN EQU 8103H
RTCHR EQU 8104H
RTCAHR EQU 8105H
RTCDAYWEEK EQU 8106H
RTCDAYMONTH EQU 8107H
RTCMONTH EQU 8108H
RTCYEAR EQU 8109H
RTCA EQU 810AH
RTCB EQU 810BH
RTCC EQU 810CH
PRESSED EQU 8116H
NEXTBTN EQU 8002H
SETSTATE EQU 8003H
TEMPSWAP1 EQU 8004H
TEMPSWAP2 EQU 8005H
PPICSR EQU 00H

ALARMPREV EQU 8117H
SEED EQU 8111H
BITS EQU 8112H
NUM1 EQU 8113H
NUM2 EQU 8114H
OPR EQU 8115H
RESULT EQU 8006H
ANSWER EQU 8007H

.ORG 0000H
	JMP 1100H
.ORG 003CH
	JMP RST7_5ISR
	
.ORG 1000H
DATA DB 03H,07H,0FH,1FH,00H,00H,00H,00H,18H,1CH,1EH,1FH,00H,00H,00H,00H
.DB 1FH,1FH,1FH,1FH
.DB 00H,00H,00H,00H
.DB 1FH,1EH,1CH,18H
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.DB 1FH,1FH,1FH,1FH

.ORG 1040H
DATA_SETTINGS DB 53H,65H,74H,74H,69H,6EH,67H,73H

.ORG 104AH
DATA_TIME DB 28H,31H,29H,0FEH,54H,69H,6DH,65H

.ORG 1053H
DATA_ALAM DB 28H,32H,29H,0FEH,41H,6CH,61H,72H,6DH

.ORG 105DH
DATA_ENTER DB 45H,6EH,74H,65H,72H,0FEH,79H,6FH,75H,72H,0FEH,63H,68H,6FH,69H,63H
.DB 65H,3AH,00H,00H

.ORG 1070H
DATA_HOUR DB 48H,6FH,75H,72H,73H,3AH

.ORG 1077H
DATA_MIN DB 4DH,69H,6EH,75H,74H,65H,73H,3AH

.ORG 1100H

MAININIT:	
		LXI SP,80FFH
		CALL PPINIT
		CALL DELAY_200MS
		CALL LCD_INIT
		CALL CGINIT
		;MVI A,0AEh
		;STA SEED
		;MVI A,2Dh
		;STA BITS
		MVI A,20h
		STA RTCA
		MVI A,03h
		STA RTCB
		MVI A,0Bh
		SIM
		EI

MAIN:		CALL NORMALDISP
		CALL ALARMCHK
		JMP MAIN

ALARMCHK:
		PUSH PSW
		LXI H,ALARMPREV
		MOV A,M
		CPI 01H
		JZ ALAM_AGAIN
		LDA RTCC
		ANI 20H
		CPI 20H
		JNZ ENDALARMCHK
		DI
		LXI H,ALARMPREV
		MVI M,01H
		
ALAM_AGAIN:
		CALL PROBGEN
		IN PORTA
		ORI 01H
		OUT PORTA
		
		MVI C,01h	;clear lcd
		CALL SEND_CMD
		MVI C,0C7H
		CALL SEND_CMD
		LXI H,NUM1
		MOV B,M
		;CALL HEXTOBCD
		CALL HEXTODECI
		CALL DDSEND
		MVI C,2BH
		CALL SEND_DATA
		LXI H,NUM2
		MOV B,M
		;CALL HEXTOBCD
		CALL HEXTODECI
		CALL DDSEND
		MVI C,3DH
		CALL SEND_DATA
		LXI H,RESULT
		MOV B,M
		;CALL HEXTOBCD
		CALL HEXTODECI
		LXI H,RESULT
		MOV M,B
		;CALL DDSEND
		MVI C,0FH
		CALL SEND_CMD
		CALL KEYPAD
		LXI H,PRESSED
		MOV A,M
		RLC 
		RLC
		RLC
		RLC
		ANI 0F0h
		MOV E,A
		LDA PRESSED
		ADI 30H
		MOV C,A
		CALL SEND_DATA
		CALL KEYPAD
		LXI H,PRESSED
		MOV A,M
		ORA E
		MOV E,A
		MOV A,E
		STA ANSWER
		LDA PRESSED
		ADI 30H
		MOV C,A
		CALL SEND_DATA
		CALL DELAY_500MS
		

		LXI H,RESULT
		LDA ANSWER
		CMP M
		JNZ ALAM_AGAIN

		;MVI C,0AH
DELALAM:	;MVI B,0FFH
DELALAM1:	
		;CALL DELAY_2MS
		;IN PORTA
		;ORI 01H
		;OUT PORTA
		;CALL DELAY_2MS
		;IN PORTA
		;ANI 0FEH
		;OUT PORTA
		;DCR B
		;JNZ DELALAM1
		;DCR C
		;JNZ DELALAM
		
		IN PORTA
		ANI 0FEH
		OUT PORTA
		MVI C,01h	;clear lcd
		CALL SEND_CMD
ENDALARMCHK:
		LXI H,ALARMPREV
		MVI M,00H
		EI
		POP PSW
		RET

NORMALDISP:
		PUSH PSW

		MVI C,80H
		CALL SEND_CMD

		LXI H,RTCDAYMONTH
		MOV B,M
		CALL DDSEND

		MVI C,2FH
		CALL SEND_DATA

		LXI H,RTCMONTH
		MOV B,M
		CALL DDSEND

		MVI C,2FH
		CALL SEND_DATA

		LXI H,RTCYEAR
		MOV B,M
		CALL DDSEND


		MVI C,89H 	;cursor is set here must auto increment till ots set again
		CALL SEND_CMD
		LXI H,DATA_ALAM
		INX H
		INX H
		INX H
		INX H
		MVI B,05h
L0:		MOV C,M 		; to display "Alarm-"
		CALL SEND_DATA
		DCR B
		JZ HERE
		INX H
		JMP L0

HERE:		MVI C,0FEH	
		CALL SEND_DATA
		LXI H,RTCAHR
		MOV B,M 		;supposed to display alarm time or infact anything other than 0, wht do you think?
		CALL DDSEND
		
		MVI C,3AH	
		CALL SEND_DATA
		
		LXI H,RTCAMIN
		MOV B,M 		;supposed to display alarm time or infact anything other than 0, wht do you think?
		CALL DDSEND	

		MVI D,06h
		LXI H,RTCHR
L3:		MOV A,M
		ANI 0F0h
		RRC		
		RRC
		RRC
		RRC

		MOV C,A
		MOV A,D
		CALL DECPS
		DCR D
		MOV A,M
		ANI 0Fh

		MOV C,A
		MOV A,D
		CALL DECPS
		DCX H
		DCX H
		DCR D
		JNZ L3

		POP PSW
		RET



PROBGEN:	PUSH PSW
		PUSH B
		LXI H,NUM1
		CALL RANDOM
		LXI H,NUM2
		CALL RANDOM
		LDA NUM1
		LXI H,NUM2
		ADD M
		STA RESULT
ENDPROB:	POP B
		POP PSW
		RET

RANDOM:		PUSH PSW ;ADDRESS PASSED IN H WHERE THE VAL SHOULD BE STORED
		PUSH B
		PUSH D
		MVI B,01H
LOOP3:		MVI D,01H
LOOP2:		CALL LFSR
		LDA SEED
		CPI 31
		JNC LOOP2
		;STC
		;CMC
		;RAR
		;STC 
		;CMC
		;RAR
		;CPI 32H
		;JNC LOOP2
		DCR D
		JNZ LOOP2
		DCR B
		JNZ LOOP3
		LDA SEED
		MOV M,A
		POP D
		POP B
		POP PSW
		RET

LFSR:	PUSH PSW ;RET VAL IN THE SEED LOC
		PUSH B
		PUSH D
		PUSH H
		LXI H,SEED
		MOV A,M
		LXI H,BITS
		ANA M
		MVI B,00H
		MVI C,08H
LOOP1:	RRC
		JNC NXT1
		INR B
NXT1:	DCR C
		JNZ LOOP1
		MOV A,B
		RLC
		RLC
		RLC
		RLC
		RLC
		RLC
		RLC
		ANI 80H
		MOV B,A
		LXI H,SEED
		MOV A,M
		STC
		CMC
		RAR
		ORA B
		STA SEED
		POP H
		POP D
		POP B
		POP PSW
		RET

CGINIT:	PUSH PSW
		PUSH B
		MVI C,40h
		CALL SEND_CMD
		MVI B,38h
		LXI H,DATA

BLKAGAIN:	   MOV C,M
	   CALL SEND_DATA
	   INX H
	   DCR B
	   JNZ BLKAGAIN
	   POP B
	   POP PSW
	   RET

DECPS:	   PUSH PSW
	   PUSH B
	   PUSH D
	   CPI 06h
	   JNZ HR2
	   MVI D,0C0h
	   MVI B,94h
	   MVI E,0D4h
	   CALL DECDAT
	   JMP CGEND

HR2:	   CPI 05h
	   JNZ MIN1L
	   MVI D,0C3h
	   MVI B,97h
	   MVI E,0D7h
	   CALL DECDAT
	   JMP CGEND

MIN1L:	   CPI 04h
	   JNZ MIN2
	   MVI D,0C7h
	   MVI B,09Bh
	   MVI E,0DBh
	   CALL DECDAT
	   JMP CGEND

MIN2:	   CPI 03h
	   JNZ SEC1
	   MVI D,0CAh
	   MVI B,09Eh
	   MVI E,0DEh
	   CALL DECDAT
	   JMP CGEND

SEC1:	   CPI 02h
	   JNZ SEC2
	   MVI D,0CEh
	   MVI B,0A2h
	   MVI E,0E2h
	   CALL DECDAT
	   JMP CGEND

SEC2:	   MVI D,0D1h
	   MVI B,0A5h
	   MVI E,0E5h
	   CALL DECDAT

CGEND:	   POP D
	   POP B
	   POP PSW
	   RET

DECDAT:	   MOV A,C
	   CPI 00h
	   JNZ ONE
	   MOV C,D
	   CALL SEND_CMD
	   MVI C,05h
	   CALL SEND_DATA
	   MVI C,02h
	   CALL SEND_DATA
	   MVI C,06h
	   CALL SEND_DATA
	   MOV C,B
	   CALL SEND_CMD
	   MVI C,0FFh
	   CALL SEND_DATA
	   MVI C,0FEh
	   CALL SEND_DATA
	   MVI C,0FFh
	   CALL SEND_DATA
	   MOV C,E
	   CALL SEND_CMD
	   MVI C,04h
	   CALL SEND_DATA
	   MVI C,02h
	   CALL SEND_DATA
	   MVI C,03h
	   CALL SEND_DATA
	   RET

ONE:	   CPI 01h
	   JNZ TWO
	   MOV C,D
	   CALL SEND_CMD
	   MVI C,00h
	   CALL SEND_DATA
	   MVI C,0FFh
	   CALL SEND_DATA
	   MVI C,0FEh
	   CALL SEND_DATA
	   MOV C,B
	   CALL SEND_CMD
	   MVI C,0FEh
	   CALL SEND_DATA
	   MVI C,0FFh
	   CALL SEND_DATA
	   MVI C,0FEh
	   CALL SEND_DATA
	   MOV C,E
	   CALL SEND_CMD
	   MVI C,02h
	   CALL SEND_DATA
	   MVI C,02h
	   CALL SEND_DATA
	   MVI C,02h
	   CALL SEND_DATA
	   RET

TWO:	   CPI 02h
	   JNZ THREE
	   MOV C,D
	   CALL SEND_CMD
	   MVI C,00h
	   CALL SEND_DATA
	   MVI C,02h
	   CALL SEND_DATA
	   MVI C,06h
	   CALL SEND_DATA
	   MOV C,B
	   CALL SEND_CMD
	   MVI C,05h
	   CALL SEND_DATA
	   MVI C,02h
	   CALL SEND_DATA
	   MVI C,03h
	   CALL SEND_DATA
	   MOV C,E
	   CALL SEND_CMD
	   MVI C,02h
	   CALL SEND_DATA
	   MVI C,02h
	   CALL SEND_DATA
	   MVI C,02h
	   CALL SEND_DATA
	   RET

THREE:	   CPI 03h
	   JNZ FOUR
	   MOV C,D
	   CALL SEND_CMD
	   MVI C,00h
	   CALL SEND_DATA
	   MVI C,02h
	   CALL SEND_DATA
	   MVI C,06h
	   CALL SEND_DATA
	   MOV C,B
	   CALL SEND_CMD
	   MVI C,0FEh
	   CALL SEND_DATA
	   MVI C,02h
	   CALL SEND_DATA
	   MVI C,0FFh
	   CALL SEND_DATA
	   MOV C,E
	   CALL SEND_CMD
	   MVI C,04h
	   CALL SEND_DATA
	   MVI C,02h
	   CALL SEND_DATA
	   MVI C,03h
	   CALL SEND_DATA
	   RET

FOUR:	   CPI 04h
	   JNZ FIVE
	   MOV C,D
	   CALL SEND_CMD
	   MVI C,0FFh
	   CALL SEND_DATA
	   MVI C,0FEh
	   CALL SEND_DATA
	   MVI C,0FFh
	   CALL SEND_DATA
	   MOV C,B
	   CALL SEND_CMD
	   MVI C,04h
	   CALL SEND_DATA
	   MVI C,02h
	   CALL SEND_DATA
	   MVI C,0FFh
	   CALL SEND_DATA
	   MOV C,E
	   CALL SEND_CMD
	   MVI C,0FEh
	   CALL SEND_DATA
	   MVI C,0FEh
	   CALL SEND_DATA
	   MVI C,02h
	   CALL SEND_DATA
	   RET

FIVE:	   CPI 05h
	   JNZ SIX
	   MOV C,D
	   CALL SEND_CMD
	   MVI C,0FFh
	   CALL SEND_DATA
	   MVI C,02h
	   CALL SEND_DATA
	   MVI C,03h
	   CALL SEND_DATA
	   MOV C,B
	   CALL SEND_CMD
	   MVI C,02h
	   CALL SEND_DATA
	   MVI C,02h
	   CALL SEND_DATA
	   MVI C,06h
	   CALL SEND_DATA
	   MOV C,E
	   CALL SEND_CMD
	   MVI C,04h
	   CALL SEND_DATA
	   MVI C,02h
	   CALL SEND_DATA
	   MVI C,03h
	   CALL SEND_DATA
	   RET

SIX:	   CPI 06h
	   JNZ SEVEN
	   MOV C,D
	   CALL SEND_CMD
	   MVI C,05h
	   CALL SEND_DATA
	   MVI C,02h
	   CALL SEND_DATA
	   MVI C,01h
	   CALL SEND_DATA
	   MOV C,B
	   CALL SEND_CMD
	   MVI C,0FFh
	   CALL SEND_DATA
	   MVI C,02h
	   CALL SEND_DATA
	   MVI C,06h
	   CALL SEND_DATA
	   MOV C,E
	   CALL SEND_CMD
	   MVI C,04h
	   CALL SEND_DATA
	   MVI C,02h
	   CALL SEND_DATA
	   MVI C,03h
	   CALL SEND_DATA
	   RET

SEVEN:	   CPI 07h
	   JNZ L8T
	   MOV C,D
	   CALL SEND_CMD
	   MVI C,04h
	   CALL SEND_DATA
	   MVI C,02h
	   CALL SEND_DATA
	   MVI C,0FFh
	   CALL SEND_DATA
	   MOV C,B
	   CALL SEND_CMD
	   MVI C,0FEh
	   CALL SEND_DATA
	   MVI C,05h
	   CALL SEND_DATA
	   MVI C,03h
	   CALL SEND_DATA
	   MOV C,E
	   CALL SEND_CMD
	   MVI C,0FEh
	   CALL SEND_DATA
	   MVI C,02h
	   CALL SEND_DATA
	   MVI C,0FEh
	   CALL SEND_DATA
	   RET

L8T:	   CPI 08h
	   JNZ NINE
	   MOV C,D
	   CALL SEND_CMD
	   MVI C,05h
	   CALL SEND_DATA
	   MVI C,02h
	   CALL SEND_DATA
	   MVI C,06h
	   CALL SEND_DATA
	   MOV C,B
	   CALL SEND_CMD
	   MVI C,05h
	   CALL SEND_DATA
	   MVI C,02h
	   CALL SEND_DATA
	   MVI C,06h
	   CALL SEND_DATA
	   MOV C,E
	   CALL SEND_CMD
	   MVI C,04h
	   CALL SEND_DATA
	   MVI C,02h
	   CALL SEND_DATA
	   MVI C,03h
	   CALL SEND_DATA
	   RET

NINE:	   MOV C,D
		CALL SEND_CMD
		MVI C,05h
		CALL SEND_DATA
		MVI C,02h
		CALL SEND_DATA
		MVI C,06h
		CALL SEND_DATA
		MOV C,B
		CALL SEND_CMD
		MVI C,04h
		CALL SEND_DATA
		MVI C,02h
		CALL SEND_DATA
		MVI C,0FFh
		CALL SEND_DATA
		MOV C,E
		CALL SEND_CMD
		MVI C,04h
		CALL SEND_DATA
		MVI C,02h
		CALL SEND_DATA
		MVI C,03h
		CALL SEND_DATA
		RET


RST7_5ISR:	
		PUSH PSW
		PUSH B
		MVI C,01h	;clear lcd
		CALL SEND_CMD
		CALL DELAY_200MS
		MVI C,80h
		CALL SEND_CMD
		MVI B,08h
		LXI H,DATA_SETTINGS
AGAIN_1:	MOV C,M
		CALL SEND_DATA
		DCR B
		JZ NXT_2
		INX H
		JMP AGAIN_1
NXT_2:		MVI C,0C0h
		CALL SEND_CMD
		MVI B,08h
		LXI H,DATA_TIME
AGAIN_2:		MOV C,M
		CALL SEND_DATA
		DCR B
		JZ NXT_3
		INX H
		JMP AGAIN_2
NXT_3:		MVI C,94h
		CALL SEND_CMD
		MVI B,09h
		LXI H,DATA_ALAM
AGAIN_3:	MOV C,M
		CALL SEND_DATA
		DCR B
		JZ NXT_4
		INX H
		JMP AGAIN_3
NXT_4:		MVI C,0D4h
		CALL SEND_CMD
		MVI B,12h
		LXI H,DATA_ENTER
AGAIN_4:	MOV C,M
		CALL SEND_DATA
		DCR B
		JZ NXT_5
		INX H
		JMP AGAIN_4

NXT_5:		MVI C,0Fh
		CALL SEND_CMD	;JMP ENDSET
AGAIN:		CALL KEYPAD
		LXI H,PRESSED
		MOV A,M
		MOV B,A
		CPI 01h
		JNZ SECOND
		ADI 30h
		MOV C,A
		CALL SEND_DATA
		JMP FORWARD
SECOND: 	CPI 02h
		JNZ AGAIN
		ADI 30h
		MOV C,A
		CALL SEND_DATA
FORWARD:	MOV A,B
		CPI 01h
		JNZ SECOND_1
		CALL TIMESET
		JMP ENDSET
	
SECOND_1:		CALL ALAMSET
		

ENDSET:	MVI A,0DBh
		SIM
		MVI A,0CBh
		SIM
		MVI C,01h	;clear lcd
		CALL SEND_CMD
		POP B
		POP PSW
		POP B
		XRA A
		MOV B,A
		MOV C,A
		EI
		JMP MAININIT
		
TIMESET:	PUSH PSW
		PUSH B
		PUSH D
		MVI A,20h
		STA RTCA
		;MVI A,83h
		;STA RTCB
		MVI C,01h
		CALL SEND_CMD
		MVI C,80h
		CALL SEND_CMD
		MVI B,06h
		LXI H,DATA_HOUR
NXT_6:		MOV C,M
		CALL SEND_DATA
		DCR B
		JZ HOURIN
		INX H
		JMP NXT_6
HOURIN:	;	CALL DELAY_500MS
		CALL KEYPAD
		LXI H,PRESSED
		MOV A,M
		CPI 00h
		JNZ ON
		MVI C,30h
		CALL SEND_DATA
		JMP S1
ON:		CPI 01h
		JNZ TW
		MVI C,31h
		CALL SEND_DATA
		JMP S1
TW:		CPI 02h
		JNZ HOURIN
		MVI C,32h
		CALL SEND_DATA
S1:		RLC 
		RLC
		RLC
		RLC
		ANI 0F0h
		MOV E,A
LOOOP:		CALL KEYPAD
		LXI H,PRESSED
		MOV A,M
		CPI 0Fh
		JZ LOOOP
		ORA E
		MOV E,A
		ANI 0Fh
		ADI 30h
		MOV C,A
		CALL SEND_DATA
		MVI A,83h
		STA RTCB
		MOV A,E
		STA RTCHR	
		MVI A,03h
		STA RTCB	

MIN1:		MVI C,0C0h
		CALL SEND_CMD
		MVI B,08h
		LXI H,DATA_MIN
NXT_7:		MOV C,M
		CALL SEND_DATA
		DCR B
		JZ MININ
		INX H
		JMP NXT_7
MININ:		CALL KEYPAD
		LXI H,PRESSED
		MOV A,M
		CPI 00h
		JNZ ON1
		MVI C,30h
		CALL SEND_DATA
		JMP S2
ON1:		CPI 01h
		JNZ TW1
		MVI C,31h
		CALL SEND_DATA
		JMP S2
TW1:		CPI 02h
		JNZ TH1
		MVI C,32h
		CALL SEND_DATA
		JMP S2
TH1:		CPI 03h
		JNZ FO1
		MVI C,33h
		CALL SEND_DATA
		JMP S2
FO1:		CPI 04h
		JNZ FI1
		MVI C,34h
		CALL SEND_DATA
		JMP S2
FI1:		CPI 05h
		JNZ MININ
		MVI C,35h
		CALL SEND_DATA
S2:		RLC 
		RLC
		RLC
		RLC
		ANI 0F0h
		MOV E,A
LOOOP1:		CALL KEYPAD
		LXI H,PRESSED
		MOV A,M
		CPI 0Fh
		JZ LOOOP1
		ORA E
		MOV E,A
		ANI 0Fh
		ADI 30h
		MOV C,A
		CALL SEND_DATA
		MVI A,83h
		STA RTCB
		MOV A,E
		STA RTCMIN
		MVI A,00h
		STA RTCSEC
		MVI A,03h
		STA RTCB
		CALL DELAY_200MS
		;MVI A,03h
		;STA RTCB
		POP D
		POP B
		POP PSW
		RET

ALAMSET:	PUSH PSW
		PUSH B
		PUSH D
		MVI A,20h
		STA RTCA
		;MVI A,83h
		;STA RTCB
		MVI C,01h
		CALL SEND_CMD
		MVI C,80h
		CALL SEND_CMD
		MVI B,06h
		LXI H,DATA_HOUR
NXT_6_2:		MOV C,M
		CALL SEND_DATA
		DCR B
		JZ HOURIN_2
		INX H
		JMP NXT_6_2
HOURIN_2:	;CALL DELAY_500MS
		CALL KEYPAD
		LXI H,PRESSED
		MOV A,M
		CPI 00h
		JNZ ON_2
		MVI C,30h
		CALL SEND_DATA
		JMP S1_2
ON_2:		CPI 01h
		JNZ TW_2
		MVI C,31h
		CALL SEND_DATA
		JMP S1_2
TW_2:		CPI 02h
		JNZ HOURIN_2
		MVI C,32h
		CALL SEND_DATA
S1_2:		RLC 
		RLC
		RLC
		RLC
		ANI 0F0h
		MOV E,A
LOOOP_2:		CALL KEYPAD
		LXI H,PRESSED
		MOV A,M
		CPI 0Fh
		JZ LOOOP_2
		ORA E
		MOV E,A
		ANI 0Fh
		ADI 30h
		MOV C,A
		CALL SEND_DATA
		MVI A,83h
		STA RTCB
		MOV A,E
		STA RTCAHR	
		MVI A,03h
		STA RTCB

MIN1_2:		MVI C,0C0h
		CALL SEND_CMD
		MVI B,08h
		LXI H,DATA_MIN
NXT_7_2:		MOV C,M
		CALL SEND_DATA
		DCR B
		JZ MININ_2
		INX H
		JMP NXT_7_2
MININ_2:		CALL KEYPAD
		LXI H,PRESSED
		MOV A,M
		CPI 00h
		JNZ ON1_2
		MVI C,30h
		CALL SEND_DATA
		JMP S2_2
ON1_2:		CPI 01h
		JNZ TW1_2
		MVI C,31h
		CALL SEND_DATA
		JMP S2_2
TW1_2:		CPI 02h
		JNZ TH1_2
		MVI C,32h
		CALL SEND_DATA
		JMP S2_2
TH1_2:		CPI 03h
		JNZ FO1_2
		MVI C,33h
		CALL SEND_DATA
		JMP S2_2
FO1_2:		CPI 04h
		JNZ FI1_2
		MVI C,34h
		CALL SEND_DATA
		JMP S2_2
FI1_2:		CPI 05h
		JNZ MININ_2
		MVI C,35h
		CALL SEND_DATA
S2_2:		RLC 
		RLC
		RLC
		RLC
		ANI 0F0h
		MOV E,A
LOOOP1_2:		CALL KEYPAD
		LXI H,PRESSED
		MOV A,M
		CPI 0Fh
		JZ LOOOP1_2
		ORA E
		MOV E,A
		ANI 0Fh
		ADI 30h
		MOV C,A
		CALL SEND_DATA
		MVI A,83h
		STA RTCB
		MOV A,E
		STA RTCAMIN
		MVI A,00h
		STA RTCASEC
		MVI A,03h
		STA RTCB
		CALL DELAY_200MS
		;MVI A,03h
		;STA RTCB
		POP D
		POP B
		POP PSW
		RET

KEYPAD:	   PUSH PSW
	   PUSH H
;	CALL DELAY_200MS
COL1:	   IN PORTA
	   ANI 0F7h
	   OUT PORTA
	   CALL DELAY_2MS
	   IN PORTC
	   ANI 0Fh

PRES1:	   CPI 0Eh
	   JNZ PRES4
	   MVI A,01h
	   JMP ENDKEYPAD

PRES4:	   CPI 0Dh
	   JNZ PRES7
	   MVI A,04h
	   JMP ENDKEYPAD

PRES7:	   CPI 0Bh
	   JNZ PRESS10
	   MVI A,07h
	   JMP ENDKEYPAD

PRESS10:	CPI 07h
	   JNZ COL2
	   MVI A,0Ah
	   JMP ENDKEYPAD

COL2:	   IN PORTA
	   ORI 38h
	   ANI 0EFh
	   OUT PORTA
	   CALL DELAY_2MS
	   IN PORTC
	   ANI 0Fh

PRES2:	   CPI 0Eh
	   JNZ PRES5
	   MVI A,02h
	   JMP ENDKEYPAD

PRES5:	   CPI 0Dh
	   JNZ PRES8
	   MVI A,05h
	   JMP ENDKEYPAD

PRES8:	   CPI 0Bh
	   JNZ PRES0
	   MVI A,08h
	   JMP ENDKEYPAD

PRES0:	   CPI 07h
	   JNZ COL3
	   MVI A,00h
	   JMP ENDKEYPAD

COL3:	   IN PORTA
	   ORI 38h
	   ANI 0DFh
	   OUT PORTA
	   CALL DELAY_2MS
	   IN PORTC
	   ANI 0Fh

PRES3:	   CPI 0Eh
	   JNZ PRES6
	   MVI A,03h
	   JMP ENDKEYPAD

PRES6:	   CPI 0Dh
	   JNZ PRES9
	   MVI A,06h
	   JMP ENDKEYPAD

PRES9:	   CPI 0Bh
	   JNZ PRESS12
	   MVI A,09h
	   JMP ENDKEYPAD

PRESS12:	   CPI 07h
	   JNZ ENDKEYPAD
	   MVI A,0Ch
	   JMP ENDKEYPAD

ENDKEYPAD:	   CPI 0Fh
	JZ COL1
	LXI H,PRESSED
	   MOV M,A
	CALL DELAY_500MS
	   IN PORTA
	   ORI 38h
	   OUT PORTA
	   POP H
	   POP PSW
	   RET






PPINIT:	   MVI A,03h
	   OUT PPICSR
	   RET

LCD_INIT:	MVI C,38h	;8bit 2 line mode
	   CALL SEND_CMD
	   MVI C,01h	;clear lcd
	   CALL SEND_CMD
	   MVI C,0Ch	;display on, cursor off, blink off
	   CALL SEND_CMD
	   MVI C,06h	; entry mode
	   CALL SEND_CMD
	   RET

SEND_DATA:	   PUSH PSW
	   MOV A,C
	   OUT PORTB
	   IN PORTA
	   ORI LCDRS
	   OUT PORTA
	   ORI LCDEN
	   OUT PORTA
	   ANI 0FBh
	   OUT PORTA
	   CALL DELAY_2MS
	   POP PSW
	   RET

SEND_CMD:	   PUSH PSW	;C fro arg
	   MOV A,C	;COMMAND OUT
	   OUT PORTB
	   IN PORTA
	   ANI 0FDh	;for making rs 0
	   OUT PORTA	;sending rs before lcd_en
	   ORI LCDEN
	   OUT PORTA
	   ANI 0FBh
	   OUT PORTA
	   CALL DELAY_2MS
	   POP PSW
	   RET

HEXTOBCD:
	PUSH PSW
	MOV A,B
	ANI 0FH
	CPI 0AH
	JC SECONDNO
	ADI 06H
	;ANI 0FH
SECONDNO:
	MOV C,A
	MOV A,B
	ANI 0F0H
	CPI 0A0H
	JC ENDHEXTOBCD
	ADI 60H
	ANI 0F0H
ENDHEXTOBCD:
	ADD C
	MOV B,A
	POP PSW
	RET

DDSEND:	PUSH PSW  
	MOV A,B
	ANI 0F0H	;SEND DATA FROM A TO LCD
	RRC
	RRC
	RRC
	RRC
	ADI 30H
	MOV C,A
	CALL SEND_DATA
	MOV A,B
	ANI 0FH
	ADI 30H
	MOV C,A
	CALL SEND_DATA
	POP PSW
	RET

HEXTODECI:
		PUSH PSW
		PUSH D
		MVI C,00H
		MOV D,B
		MOV A,D
		RAR
		JNC SHFT1
		MOV A,C
		ADI 01H
		MOV C,A

SHFT1:	MOV A,D
		RAR
		RAR
		JNC SHFT2
		MOV A,C
		ADI 02H
		MOV C,A

SHFT2:	MOV A,D
		RAR
		RAR
		RAR
		JNC SHFT3
		MOV A,C
		ADI 04H
		MOV C,A

SHFT3:	MOV A,D
		RAR
		RAR
		RAR
		RAR
		JNC SHFT4
		MOV A,C
		ADI 08H
		MOV B,A
		CALL HEXTOBCD
		MOV C,B

SHFT4:	MOV A,D
		RAR
		RAR
		RAR
		RAR
		RAR
		JNC SHFT5
		MOV A,C
		ADI 16H
		MOV B,A
		CALL HEXTOBCD
		MOV C,B

SHFT5:	MOV A,D
		RAR
		RAR
		RAR
		RAR
		RAR
		RAR
		JNC ENDHEXTODECI
		MOV A,C
		ADI 32H
		MOV B,A
		CALL HEXTOBCD
		MOV C,B


ENDHEXTODECI:
		MOV B,C
		POP D
		POP PSW
		RET




DELAY_2MS:	
		PUSH PSW
		PUSH B
		LXI B,0103h

DELAY_2MSLOOP:	   
		DCX B
		MOV A,B
		ORA C
		JNZ DELAY_2MSLOOP
		POP B
		POP PSW
		RET
DELAY_200MS:
		PUSH PSW
		PUSH D
		LXI D,65B8h
DELAY_200MSLoop:
		DCX D
		MOV A,D
		ORA E
		JNZ DELAY_200MSLoop
		POP D
		POP PSW
		RET
	
DELAY_500MS:
		PUSH PSW
		PUSH D
		LXI D,0FE4Fh
DELAY_500MSLoop:
		DCX D
		MOV A,D
		ORA E
		JNZ DELAY_500MSLoop
		POP D  
		POP PSW
		RET
	
DELAY_1S:
	PUSH B
	PUSH D
	MVI B,1FH
DELAY_1SLOOP1:
	MVI C,4AH
DELAY_1SLOOP2:
	MVI D,60H
DELAY_1SLOOP3:
	DCR D
	JNZ DELAY_1SLOOP3
	DCR C
	JNZ DELAY_1SLOOP2
	DCR B
	JNZ DELAY_1SLOOP1
	POP D
	POP B
	RET
